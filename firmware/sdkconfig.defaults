## firmware/sdkconfig.defaults
```kconfig
# Zigbee End Device
CONFIG_ZB_ENABLED=y
CONFIG_ZB_ED_ROLE=y
CONFIG_ZB_RADIO_MODE_NATIVE=y
CONFIG_ZB_HOST_MODE_NONE=y

# BLE (NimBLE — GATT client for treadmill control)
CONFIG_BT_ENABLED=y
CONFIG_BT_NIMBLE_ENABLED=y
CONFIG_BT_NIMBLE_ROLE_CENTRAL=y
CONFIG_BT_NIMBLE_ROLE_OBSERVER=y
CONFIG_BT_NIMBLE_ROLE_PERIPHERAL=n
CONFIG_BT_NIMBLE_ROLE_BROADCASTER=n
CONFIG_BT_BLE_DYNAMIC_ENV_MEMORY=y

# BLE + 802.15.4 coexistence
CONFIG_ESP_COEX_SW_COEXIST_ENABLE=y

# Chip revision (M5Stack Nano H2 v1.2)
CONFIG_ESP32H2_REV_MIN_1=y
CONFIG_ESP32H2_REV_MIN_FULL=102
CONFIG_ESP_REV_MIN_FULL=102
CONFIG_ESP32H2_REV_MAX_FULL=199

# Custom partition table
CONFIG_PARTITION_TABLE_CUSTOM=y
CONFIG_PARTITION_TABLE_CUSTOM_FILENAME="partitions.csv"

# Logging
CONFIG_LOG_DEFAULT_LEVEL_INFO=y

# GPIO
CONFIG_GPIO_CTRL_FUNC_IN_IRAM=y
```
